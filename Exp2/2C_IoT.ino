#include <Wire.h>
#include <Adafruit_GFX.h>
#include <Adafruit_SSD1306.h>

#define SCREEN_WIDTH 128
#define SCREEN_HEIGHT 64
#define OLED_RESET -1
Adafruit_SSD1306 display(SCREEN_WIDTH, SCREEN_HEIGHT, &Wire, OLED_RESET);

static const unsigned char PROGMEM big_smiley_bmp[] = {
  0x00,0x00,0x00,0x00,
  0x03,0xFF,0xFF,0xC0,
  0x0E,0x00,0x00,0x38,
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  0x00,0x00,0x00,0x00
};

int x = 0, dx = 2;
int bx = 48, by = 16, bdx = 2, bdy = 1;
int scrollPos = 0;

String banner = " ARDUINO + OLED = BIG SMILE!  ";
unsigned long lastScroll = 0;

void setup() {
  display.begin(SSD1306_SWITCHCAPVCC, 0x3C);
  display.clearDisplay();
  display.setTextColor(SSD1306_WHITE);
}

void loop() {
  display.clearDisplay();

  display.setTextSize(2);
  display.setCursor(x, 0);
  display.print("FUN!");

  x += dx;
  if (x <= 0 || x >= SCREEN_WIDTH - (4 * 6 * 2)) dx = -dx;

  display.drawBitmap(bx, by, big_smiley_bmp, 32, 32, SSD1306_WHITE);
  bx += bdx;
  by += bdy;

  if (bx <= 0 || bx >= SCREEN_WIDTH - 32) bdx = -bdx;
  if (by <= 20 || by >= SCREEN_HEIGHT - 32) bdy = -bdy;

  int bigNum = (millis() / 150) % 9999;
  display.setTextSize(2);
  display.setCursor(0, 36);
  display.print(bigNum);
  display.setCursor(72, 36);
  display.print(bigNum, HEX);

  display.setTextSize(1);
  int textWidth = banner.length() * 6;

  if (millis() - lastScroll > 40) {
    scrollPos++;
    if (scrollPos > textWidth + SCREEN_WIDTH) scrollPos = 0;
    lastScroll = millis();
  }

  display.setCursor(SCREEN_WIDTH - scrollPos, 56);
  display.print(banner);

  display.display();
  delay(25);
}
